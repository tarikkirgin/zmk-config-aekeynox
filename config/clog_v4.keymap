#define SELENIUM_KEYMAP_BINDINGS(LOUT1,  LROW1,  RROW1,  ROUT1, \
                                 LOUT2,  LROW2,  RROW2,  ROUT2, \
                                 LOUT3,  LROW3,  RROW3,  ROUT3, \
                                 LT1, LT2, LT3,  RT3, RT2, RT1) \
      LROW1   RROW1 \
      LROW2   RROW2 \
      LROW3   RROW3 \
    LT1 LT2   RT2 RT1

#define FOUR_THUMB_KEYS

&default_transform {
  redirection-table = <
          1  2  3  4    5  6  7  8
    0 10 11 12 13 14    15 16 17 18 19  9
      20 21 22 23 24    25 26 27 28 29
               30 31    32 33
    >;
};

#include <aekeynox/selenium.keymap>
